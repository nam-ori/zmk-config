## boards/shields/totem/Kconfig.defconfig
```kconfig
# Copyright (c) 2022 The ZMK Contributors
# SPDX-License-Identifier: MIT

if SHIELD_TOTEM_LEFT

config ZMK_KEYBOARD_NAME
    default "TOTEM"
    
config ZMK_SPLIT_ROLE_CENTRAL
    default y

endif

if SHIELD_TOTEM_LEFT || SHIELD_TOTEM_RIGHT

config CONFIG_ZMK_USB
    default n

config ZMK_BLE_EXPERIMENTAL_CONN
    default y

config ZMK_SPLIT
    default y

endif
```

## config/west.yml
```yaml
manifest:
  defaults:
    revision: main
  remotes:
    - name: zmkfirmware
      url-base: https://github.com/zmkfirmware
#    - name: bildermankawasaki
#      url-base: https://github.com/bildermankawasaki
    - name: cfergeau
      url-base: https://github.com/cfergeau
    - name: urob
      url-base: https://github.com/urob
    - name: ArturitoGit
      url-base: https://github.com/ArturitoGit
  projects:
    - name: zmk
      remote: zmkfirmware
      import: app/west.yml
      revision: main
#    - name: zmk-keyboard-totem
#      remote: bildermankawasaki
    - name: zmk-config-totem
      remote: cfergeau
      revision: zmk-module
    - name: zmk-helpers
      remote: urob
      revision: main # Should match ZMK release.
    - name: zmk-leader-key
      remote: urob
      revision: main # Should match ZMK release.
    - name: zmk-behavior-locale-capsword
      revision: main
      remote: ArturitoGit
  self:
    path: config
```
