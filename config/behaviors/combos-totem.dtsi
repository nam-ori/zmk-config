#include "zmk-helpers/key-labels/totem.h"
#include "./combos.dtsi"

// NOTE: Only combos with the 6th column here (spec. to Totem)
//       All other combos should be in ./combos.dtsi


// ALT+SHIFT - Bottom left 2 keys, active on all layers except game
ZMK_COMBO(altshift, &kp LA(LSHFT), LB5 LB4, ERL ERG NUM NUA SYM FCT EAC)

// CHANGE QWERTY <-> ERGO-L - Bottom left 3 keys, active on all layers except game
ZMK_COMBO(qw2ergol, &tog ERG, LB5 LB4 LB3, ERL ERG NUM NUA SYM FCT EAC)

// NUM Toggle - Both thumbs, active on all inferior layers
ZMK_COMBO(num_toggle_r, &tog NUM, RB5 RH0, ERL ERG NUM)
ZMK_COMBO(num_toggle_l, &tog NUM, LB5 LH0, ERL ERG NUM)

// SYM Toggle - Right thumb, active on all Ergo-l-AZERTY inferior layers
ZMK_COMBO(altgr_toggle, &kt AR, RB5 RH1, ERL NUM)
ZMK_COMBO(sym_toggle, &tog SYM, RB5 RH1, ERG NUA SYM)

// FCT Toggle - Left thumbs, active on all inferior layers (easy access to arrows)
ZMK_COMBO(nav_toggle, &tog FCT, LB5 LH2, ERL ERG NUM NUA SYM FCT)

// Caps Lock Toggle - Left thumbs, active on all inferior layers except game
ZMK_COMBO(capslock_thumbs, &kp CAPSLOCK, LB5 LH1, ERL ERG NUM NUA SYM FCT EAC)
