#include "zmk-helpers/helper.h"
// Combos
#undef COMBO_TERM
#define COMBO_TERM 45  // timeout of 45ms (default is 30ms if omitted)
//#define HR_TIMEOUT 30  // timeout on homerow is better a bit shorter

/***********************
  ALL LAYERS
***********************/

// CUT - Ctrl + X, active on all layers
ZMK_COMBO(cut_lefthand, &kp LC(X), LB1 LB3, ERL ERG NUM NUA SYM FCT EAC)

// COPY - Ctrl + C, active on ergol-based layers
ZMK_COMBO(copy_ergol, &kp LC(W), LB2 LB3, ERL NUM FCT)
// COPY - Ctrl + C, active on azerty-based layers except gaming
ZMK_COMBO(copy_azerty, &kp LC(C), LB2 LB3, ERG NUA SYM EAC)

// PASTE - Ctrl + V, active on all layers
ZMK_COMBO(paste_lefthand, &kp LC(V), LB1 LB2, ERL ERG NUM NUA SYM FCT EAC)

// ENTER - Return, active on all layers
ZMK_COMBO(return_bot, &kp RET, RB1 RB2 RB3, ERL ERG NUM NUA SYM FCT EAC)

/***********************
  BASE LAYERS
***********************/

// PRINT SCREEN - PrintScreen, active on base layers
ZMK_COMBO(printscreen_top, &kp PRINTSCREEN, RT3 RT4, ERL ERG)

// BACKSPACE - active on base layers
ZMK_COMBO(backspace_top, &kp BSPC, RT1 RT2, ERL ERG)

// DEL - active on base layers
ZMK_COMBO(del_top, &kp DEL, RT2 RT3, ERL ERG)

// DEL WORD - Ctrl Backspace, active on base layers
ZMK_COMBO(del_word_top, &kp LC(BSPC), RT1 RT2 RT3, ERL ERG)

// CAPS WORD - Both HR Shifts, active on base & accent layers
ZMK_COMBO(capsword_e, &cword, LM1 RM1, ERL)
ZMK_COMBO(capsword_a, &cword_az, LM1 RM1, ERG EAC)

// CAPS LOCK - Both HR Controls, active on base & accent layers
ZMK_COMBO(capslock_hmr, &kp CAPSLOCK, LM2 RM2, ERL ERG EAC)

// Toggle Game Layer - active on base and game layer
ZMK_COMBO(toggle_game, &tog GAM, RT1 RT4, ERL ERG GAM)

/***********************
  OPERATION LAYER
***********************/

// LOCK SCREEN
ZMK_COMBO(lockscreen, &kp C_AL_LOCK, RT1 RT2, FCT)

// TURN OFF COMPUTER
ZMK_COMBO(turnoff, &kp C_POWER, RT1 RT2 RT3,FCT)

/***********************
  THUMBS
***********************/

