// Adapted from https://github.com/JeffDess/zmk-config/blob/main/behaviors/combos_36.dtsi
#include "./combos.dtsi"

// NOTE: Only thumb keys are different between 34/36 layouts
//       All other combos should be in ./combos.dtsi

/***********************
  THUMBS
***********************/

// TAB - Inner right thumbs, active on all alpha layers
ZMK_COMBO(tab, &kp TAB, RH0 RH1, ERG)

// NAV Toggle - Left thumbs, active on all alpha layers & NAV
ZMK_COMBO(nav_toggle, &tog NAV, LH0 LH1, ERG NAV)

// ALT+SHIFT - Inner right thumbs, active on all alpha layers
ZMK_COMBO(altshift, &kp LA(LSHFT), LB5 LB4, ERG)
