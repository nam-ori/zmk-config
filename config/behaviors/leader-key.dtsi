/ {
    behaviors {
        odkleader: onedeadkeyleader {
            compatible = "zmk,behavior-leader-key";
            #binding-cells = <0>;
            ignore-keys = <LSHFT RSHFT>;
            odk_h { sequence = <M>; bindings = <&kp PERIOD>; };
        };
    };
};
