// To go to accent layer just for one character
// (sticky layer for dead key)

/* should be ok with zmk helpers but doesn't work… so add the normal one hereafter
ZMK_AUTO_LAYER(onech,
    continue-list = <>;
    ignore-modifiers;
)
*/

/ {
  behaviors {
    onech: one_character {
      compatible = "zmk,behavior-auto-layer";
      #binding-cells = <1>;
      continue-list = <>;
      ignore-modifiers;
    };
  };
};
