/ {
    conditional_layers {
        compatible = "zmk,conditional-layers";
        auto_num {
            if-layers = <NUH>;
            then-layer = <NUM>;
        };
        auto_nua {
            if-layers = <ERG NUM>;
            then-layer = <NUA>;
        };
    };
};
