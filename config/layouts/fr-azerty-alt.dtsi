/* French Alternative Legacy Mappings for:
 * Linux ("Français (variante)")
 * Linux ("Français (variante)")
 * Windows ("Français (Traditionnel, AZERTY)") 
 * 
 * Keys are defined as in the layout, 
 * from left to right, top to bottom.
 * Missing keys are defined at the end;
 * feel free to append those with keys needed in your layouts
 */


#ifndef OS_LAYOUT
  #define OS_LAYOUT AZERTY_ALT
#endif

#include "commons.dtsi"

/* Note: includes dead keys (waiting to be combined)
 * named:
 *          CD_     for: "Combined Diacritic"
 *          CD_I_   for: "Combined Diacritic - Inverted"
 *          CD_D_   for: "Combined Diacritic - Double"
 *          DK_     for: "(other) Dead Key"
 *          NB_     for: "No-Break" or "Non-Breaking"
 */

// num row

#define AZERTY_ALT_KEY_EXPON_2 GRAVE
#define AZERTY_ALT_KEY_EXPON_3 LS(GRAVE)
#define AZERTY_ALT_KEY_EXPON_1 RA(GRAVE)
#define AZERTY_ALT_KEY_CD_CEDILLA LS(RA(GRAVE))

#define AZERTY_ALT_KEY_AMPS N1
#define AZERTY_ALT_KEY_N1 LS(N1)
#define AZERTY_ALT_KEY_CD_CARON RA(N1)
#define AZERTY_ALT_KEY_CD_OGONEK LS(RA(N1))

#define AZERTY_ALT_KEY_E_ACUTE N2
#define AZERTY_ALT_KEY_N2 LS(N2)
#define AZERTY_ALT_KEY_TILDE RA(N2)
#define AZERTY_ALT_KEY_E_ACUTE_UP LS(RA(N2))

#define AZERTY_ALT_KEY_DQT N3
#define AZERTY_ALT_KEY_N3 LS(N3)
#define AZERTY_ALT_KEY_HASH RA(N3)
#define AZERTY_ALT_KEY_CD_BREVE LS(RA(N3))

#define AZERTY_ALT_KEY_SQT N4
#define AZERTY_ALT_KEY_N4 LS(N4)
#define AZERTY_ALT_KEY_LBRC RA(N4)
#define AZERTY_ALT_KEY_EM_DASH LS(RA(N4))

#define AZERTY_ALT_KEY_LPAR N5
#define AZERTY_ALT_KEY_N5 LS(N5)
#define AZERTY_ALT_KEY_LBKT RA(N5)
#define AZERTY_ALT_KEY_EN_DASH LS(RA(N5))

#define AZERTY_ALT_KEY_MINUS N6
#define AZERTY_ALT_KEY_N6 LS(N6)
#define AZERTY_ALT_KEY_PIPE RA(N6)
#define AZERTY_ALT_KEY_NB_HYPHEN LS(RA(N6))

#define AZERTY_ALT_KEY_E_GRAVE N7
#define AZERTY_ALT_KEY_N7 LS(N7)
#define AZERTY_ALT_KEY_GRAVE RA(N7)
#define AZERTY_ALT_KEY_E_GRAVE_UP LS(RA(N7))

#define AZERTY_ALT_KEY_UNDER N8
#define AZERTY_ALT_KEY_N8 LS(N8)
#define AZERTY_ALT_KEY_BSLH RA(N8)
#define AZERTY_ALT_KEY_TM LS(RA(N8))

#define AZERTY_ALT_KEY_C_CEDIL N9
#define AZERTY_ALT_KEY_N9 LS(N9)
#define AZERTY_ALT_KEY_CARET RA(N9)
#define AZERTY_ALT_KEY_C_CEDIL_UP LS(RA(N9))

#define AZERTY_ALT_KEY_A_GRAVE N0
#define AZERTY_ALT_KEY_N0 LS(N0)
#define AZERTY_ALT_KEY_AT RA(N0)
#define AZERTY_ALT_KEY_A_GRAVE_UP LS(RA(N0))

#define AZERTY_ALT_KEY_RPAR MINUS
#define AZERTY_ALT_KEY_DEGREE LS(MINUS)
#define AZERTY_ALT_KEY_RBKT RA(MINUS)
#define AZERTY_ALT_KEY_MATH_DIF LS(RA(MINUS))

#define AZERTY_ALT_KEY_EQUAL EQUAL
#define AZERTY_ALT_KEY_PLUS LS(EQUAL)
#define AZERTY_ALT_KEY_RBRC RA(EQUAL)
#define AZERTY_ALT_KEY_MATH_PM LS(RA(EQUAL))

// top letter row

#define AZERTY_ALT_KEY_A Q
#define AZERTY_ALT_KEY_AE RA(Q)
#define AZERTY_ALT_KEY_AE_UP LS(RA(Q))

#define AZERTY_ALT_KEY_Z W
#define AZERTY_ALT_KEY_A_CIRCU RA(W)
#define AZERTY_ALT_KEY_A_CIRCU_UP LS(RA(W))

#define AZERTY_ALT_KEY_E E
#define AZERTY_ALT_KEY_EURO RA(E)
#define AZERTY_ALT_KEY_CENT LS(RA(E))

#define AZERTY_ALT_KEY_R R
#define AZERTY_ALT_KEY_E_CIRCU RA(R)
#define AZERTY_ALT_KEY_E_CIRCU_UP LS(RA(R))

#define AZERTY_ALT_KEY_T T
#define AZERTY_ALT_KEY_THORN RA(T)
#define AZERTY_ALT_KEY_THORN_UP LS(RA(T))

#define AZERTY_ALT_KEY_Y Y
#define AZERTY_ALT_KEY_Y_DIAER RA(Y)
#define AZERTY_ALT_KEY_Y_DIAER_UP LS(RA(Y))

#define AZERTY_ALT_KEY_U U
#define AZERTY_ALT_KEY_U_CIRCU RA(U)
#define AZERTY_ALT_KEY_U_CIRCU_UP LS(RA(U))

#define AZERTY_ALT_KEY_I I
#define AZERTY_ALT_KEY_I_CIRCU RA(I)
#define AZERTY_ALT_KEY_I_CIRCU_UP LS(RA(I))

#define AZERTY_ALT_KEY_O O
#define AZERTY_ALT_KEY_OE RA(O)
#define AZERTY_ALT_KEY_OE_UP LS(RA(O))

#define AZERTY_ALT_KEY_P P
#define AZERTY_ALT_KEY_O_CIRCU RA(P)
#define AZERTY_ALT_KEY_O_CIRCU_UP LS(RA(P))

#define AZERTY_ALT_KEY_CD_CIRCU LBKT
#define AZERTY_ALT_KEY_CD_DIAER LS(LBKT)
#define AZERTY_ALT_KEY_CD_TILDE RA(LBKT)
#define AZERTY_ALT_KEY_CD_RING LS(RA(LBKT))

#define AZERTY_ALT_KEY_DLLR RBKT
#define AZERTY_ALT_KEY_UK_POUND LS(RBKT)
#define AZERTY_ALT_KEY_O_STROKE RA(RBKT)
#define AZERTY_ALT_KEY_O_STROKE_UP LS(RA(RBKT))

// mid letter row

#define AZERTY_ALT_KEY_Q A
#define AZERTY_ALT_KEY_A_DIAER RA(A)
#define AZERTY_ALT_KEY_A_DIAER_UP LS(RA(A))

#define AZERTY_ALT_KEY_S S
#define AZERTY_ALT_KEY_SHARP_S RA(S)
#define AZERTY_ALT_KEY_LOW_DQT LS(RA(S))

#define AZERTY_ALT_KEY_D D
#define AZERTY_ALT_KEY_E_DIAER RA(D)
#define AZERTY_ALT_KEY_E_DIAER_UP LS(RA(D))

#define AZERTY_ALT_KEY_F F
#define AZERTY_ALT_KEY_L_SQT RA(F)
#define AZERTY_ALT_KEY_LOW_SQT LS(RA(F))

#define AZERTY_ALT_KEY_G G
#define AZERTY_ALT_KEY_R_SQT RA(G)
#define AZERTY_ALT_KEY_YEN LS(RA(G))

#define AZERTY_ALT_KEY_H H
#define AZERTY_ALT_KEY_ETH RA(H)
#define AZERTY_ALT_KEY_ETH_UP LS(RA(H))

#define AZERTY_ALT_KEY_J J
#define AZERTY_ALT_KEY_U_DIAER RA(J)
#define AZERTY_ALT_KEY_U_DIAER_UP LS(RA(J))

#define AZERTY_ALT_KEY_K K
#define AZERTY_ALT_KEY_I_DIAER RA(K)
#define AZERTY_ALT_KEY_I_DIAER_UP LS(RA(K))

#define AZERTY_ALT_KEY_L L
#define AZERTY_ALT_KEY_L_DOT RA(L)
#define AZERTY_ALT_KEY_L_DOT_UP LS(RA(L))

#define AZERTY_ALT_KEY_M SEMI
#define AZERTY_ALT_KEY_O_DIAER RA(SEMI)
#define AZERTY_ALT_KEY_O_DIAER_UP LS(RA(SEMI))

#define AZERTY_ALT_KEY_U_GRAVE SQT
#define AZERTY_ALT_KEY_PRCNT LS(SQT)
#define AZERTY_ALT_KEY_CD_ACUTE RA(SQT)
#define AZERTY_ALT_KEY_U_GRAVE_UP LS(RA(SQT))

#define AZERTY_ALT_KEY_STAR NUHS
#define AZERTY_ALT_KEY_MICRO LS(NUHS)
#define AZERTY_ALT_KEY_CD_GRAVE RA(NUHS)
#define AZERTY_ALT_KEY_CD_MACRON LS(RA(NUHS))

// low letter row

#define AZERTY_ALT_KEY_LT NUBS
#define AZERTY_ALT_KEY_GT LS(NUBS)
#define AZERTY_ALT_KEY_LET RA(NUBS)
#define AZERTY_ALT_KEY_GET LS(RA(NUBS))

#define AZERTY_ALT_KEY_W Z
#define AZERTY_ALT_KEY_L_ANG_DQT RA(Z)
#define AZERTY_ALT_KEY_L_DQT LS(RA(Z))

#define AZERTY_ALT_KEY_X X
#define AZERTY_ALT_KEY_R_ANG_DQT RA(X)
#define AZERTY_ALT_KEY_R_DQT LS(RA(X))

#define AZERTY_ALT_KEY_C C
#define AZERTY_ALT_KEY_COPYRIGHT RA(C)
#define AZERTY_ALT_KEY_REG LS(RA(C))

#define AZERTY_ALT_KEY_V V
// narrow space prefered on space for compatibility with legacy AZERTY
// #define AZERTY_ALT_KEY_NAR_SPACE RA(V)
#define AZERTY_ALT_KEY_L_ARROW LS(RA(V))

#define AZERTY_ALT_KEY_B B
#define AZERTY_ALT_KEY_D_ARROW RA(B)
#define AZERTY_ALT_KEY_U_ARROW LS(RA(V))

#define AZERTY_ALT_KEY_N N
#define AZERTY_ALT_KEY_NEGATION RA(N)
#define AZERTY_ALT_KEY_R_ARROW LS(RA(N))

#define AZERTY_ALT_KEY_COMMA M
#define AZERTY_ALT_KEY_QMARK LS(M)
#define AZERTY_ALT_KEY_I_QMARK RA(M)
#define AZERTY_ALT_KEY_ELLIPS LS(RA(M))

#define AZERTY_ALT_KEY_SEMI COMMA
#define AZERTY_ALT_KEY_PERIOD LS(COMMA)
#define AZERTY_ALT_KEY_MULTIPL RA(COMMA)
#define AZERTY_ALT_KEY_MID_DOT LS(RA(COMMA))

#define AZERTY_ALT_KEY_COLON DOT
#define AZERTY_ALT_KEY_FSLH LS(DOT)
#define AZERTY_ALT_KEY_MATH_DIV RA(DOT)
#define AZERTY_ALT_KEY_DIVSLH LS(RA(DOT))

#define AZERTY_ALT_KEY_EXCL SLASH
#define AZERTY_ALT_KEY_SECTION LS(SLASH)
#define AZERTY_ALT_KEY_I_EXCL RA(SLASH)
#define AZERTY_ALT_KEY_MATH_MINUS LS(RA(SLASH))



// spaebar

#define AZERTY_ALT_KEY_SPACE SPACE
#define AZERTY_ALT_KEY_NB_SPACE RA(SPACE)
#define AZERTY_ALT_KEY_NAR_SPACE LS(RA(SPACE))

// combined keys for a character (combined diacritic) - single kp with this keyboard

#define AZERTY_ALT_COMBINED_A_GRAVE &kp AZERTY_ALT_KEY_A_GRAVE
#define AZERTY_ALT_COMBINED_A_GRAVE_UP &kp AZERTY_ALT_KEY_A_GRAVE_UP
#define AZERTY_ALT_COMBINED_A_CIRCU &kp AZERTY_ALT_KEY_A_CIRCU
#define AZERTY_ALT_COMBINED_A_CIRCU_UP &kp AZERTY_ALT_KEY_A_CIRCU_UP
#define AZERTY_ALT_COMBINED_A_DIAER &kp AZERTY_ALT_KEY_A_DIAER
#define AZERTY_ALT_COMBINED_A_DIAER_UP &kp AZERTY_ALT_KEY_A_DIAER_UP
#define AZERTY_ALT_COMBINED_E_GRAVE &kp AZERTY_ALT_KEY_E_GRAVE
#define AZERTY_ALT_COMBINED_E_GRAVE_UP &kp AZERTY_ALT_KEY_E_GRAVE_UP
#define AZERTY_ALT_COMBINED_E_ACUTE &kp AZERTY_ALT_KEY_E_ACUTE
#define AZERTY_ALT_COMBINED_E_ACUTE_UP &kp AZERTY_ALT_KEY_E_ACUTE_UP
#define AZERTY_ALT_COMBINED_E_CIRCU &kp AZERTY_ALT_KEY_E_CIRCU
#define AZERTY_ALT_COMBINED_E_CIRCU_UP &kp AZERTY_ALT_KEY_E_CIRCU_UP
#define AZERTY_ALT_COMBINED_E_DIAER &kp AZERTY_ALT_KEY_E_DIAER
#define AZERTY_ALT_COMBINED_E_DIAER_UP &kp AZERTY_ALT_KEY_E_DIAER_UP
#define AZERTY_ALT_COMBINED_I_CIRCU &kp AZERTY_ALT_KEY_I_CIRCU
#define AZERTY_ALT_COMBINED_I_CIRCU_UP &kp AZERTY_ALT_KEY_I_CIRCU_UP
#define AZERTY_ALT_COMBINED_I_DIAER &kp AZERTY_ALT_KEY_I_DIAER
#define AZERTY_ALT_COMBINED_I_DIAER_UP &kp AZERTY_ALT_KEY_I_DIAER_UP
#define AZERTY_ALT_COMBINED_O_CIRCU &kp AZERTY_ALT_KEY_O_CIRCU
#define AZERTY_ALT_COMBINED_O_CIRCU_UP &kp AZERTY_ALT_KEY_O_CIRCU_UP
#define AZERTY_ALT_COMBINED_O_DIAER &kp AZERTY_ALT_KEY_O_DIAER
#define AZERTY_ALT_COMBINED_O_DIAER_UP &kp AZERTY_ALT_KEY_O_DIAER_UP
#define AZERTY_ALT_COMBINED_U_GRAVE &kp AZERTY_ALT_KEY_U_GRAVE
#define AZERTY_ALT_COMBINED_U_GRAVE_UP &kp AZERTY_ALT_KEY_U_GRAVE_UP
#define AZERTY_ALT_COMBINED_U_CIRCU &kp AZERTY_ALT_KEY_U_CIRCU
#define AZERTY_ALT_COMBINED_U_CIRCU_UP &kp AZERTY_ALT_KEY_U_CIRCU_UP
#define AZERTY_ALT_COMBINED_U_DIAER &kp AZERTY_ALT_KEY_U_DIAER
#define AZERTY_ALT_COMBINED_U_DIAER_UP &kp AZERTY_ALT_KEY_U_DIAER_UP
#define AZERTY_ALT_COMBINED_Y_DIAER &kp AZERTY_ALT_KEY_Y_DIAER
#define AZERTY_ALT_COMBINED_Y_DIAER_UP &kp AZERTY_ALT_KEY_Y_DIAER_UP
#define AZERTY_ALT_COMBINED_C_CEDIL &kp AZERTY_ALT_KEY_C_CEDIL
#define AZERTY_ALT_COMBINED_C_CEDIL_UP &kp AZERTY_ALT_KEY_C_CEDIL_UP

// combined keys for a character (others)

#define AZERTY_ALT_COMBINED_MICRO &kp AZERTY_ALT_KEY_MICRO
#define AZERTY_ALT_COMBINED_CARET &kp AZERTY_ALT_KEY_CARET
#define AZERTY_ALT_COMBINED_ACUTE &kp AZERTY_ALT_KEY_CD_ACUTE &kp AZERTY_ALT_KEY_SPACE
#define AZERTY_ALT_COMBINED_GRAVE &kp AZERTY_ALT_KEY_CD_GRAVE &kp AZERTY_ALT_KEY_SPACE
#define AZERTY_ALT_COMBINED_TILDE &kp AZERTY_ALT_KEY_TILDE
#define AZERTY_ALT_COMBINED_EXPON_1 &kp AZERTY_ALT_KEY_CD_CIRCU &kp AZERTY_ALT_KEY_N1
#define AZERTY_ALT_COMBINED_INDEX_1 &kp AZERTY_ALT_KEY_CD_CARON &kp AZERTY_ALT_KEY_N1
#define AZERTY_ALT_COMBINED_EXPON_2 &kp AZERTY_ALT_KEY_CD_CIRCU &kp AZERTY_ALT_KEY_N2
#define AZERTY_ALT_COMBINED_INDEX_2 &kp AZERTY_ALT_KEY_CD_CARON &kp AZERTY_ALT_KEY_N2
#define AZERTY_ALT_COMBINED_EXPON_3 &kp AZERTY_ALT_KEY_CD_CIRCU &kp AZERTY_ALT_KEY_N3
#define AZERTY_ALT_COMBINED_INDEX_3 &kp AZERTY_ALT_KEY_CD_CARON &kp AZERTY_ALT_KEY_N3
#define AZERTY_ALT_COMBINED_EXPON_4 &kp AZERTY_ALT_KEY_CD_CIRCU &kp AZERTY_ALT_KEY_N4
#define AZERTY_ALT_COMBINED_INDEX_4 &kp AZERTY_ALT_KEY_CD_CARON &kp AZERTY_ALT_KEY_N4
#define AZERTY_ALT_COMBINED_EXPON_5 &kp AZERTY_ALT_KEY_CD_CIRCU &kp AZERTY_ALT_KEY_N5
#define AZERTY_ALT_COMBINED_INDEX_5 &kp AZERTY_ALT_KEY_CD_CARON &kp AZERTY_ALT_KEY_N5
#define AZERTY_ALT_COMBINED_EXPON_6 &kp AZERTY_ALT_KEY_CD_CIRCU &kp AZERTY_ALT_KEY_N6
#define AZERTY_ALT_COMBINED_INDEX_6 &kp AZERTY_ALT_KEY_CD_CARON &kp AZERTY_ALT_KEY_N6
#define AZERTY_ALT_COMBINED_EXPON_7 &kp AZERTY_ALT_KEY_CD_CIRCU &kp AZERTY_ALT_KEY_N7
#define AZERTY_ALT_COMBINED_INDEX_7 &kp AZERTY_ALT_KEY_CD_CARON &kp AZERTY_ALT_KEY_N7
#define AZERTY_ALT_COMBINED_EXPON_8 &kp AZERTY_ALT_KEY_CD_CIRCU &kp AZERTY_ALT_KEY_N8
#define AZERTY_ALT_COMBINED_INDEX_8 &kp AZERTY_ALT_KEY_CD_CARON &kp AZERTY_ALT_KEY_N8
#define AZERTY_ALT_COMBINED_EXPON_9 &kp AZERTY_ALT_KEY_CD_CIRCU &kp AZERTY_ALT_KEY_N9
#define AZERTY_ALT_COMBINED_INDEX_9 &kp AZERTY_ALT_KEY_CD_CARON &kp AZERTY_ALT_KEY_N9
#define AZERTY_ALT_COMBINED_EXPON_0 &kp AZERTY_ALT_KEY_CD_CIRCU &kp AZERTY_ALT_KEY_N0
#define AZERTY_ALT_COMBINED_INDEX_0 &kp AZERTY_ALT_KEY_CD_CARON &kp AZERTY_ALT_KEY_N0

// undefined keys in this layout - append if needed!

#define AZERTY_ALT_KEY_BULLET 0
#define AZERTY_ALT_KEY_FRAC_3_4 0
#define AZERTY_ALT_KEY_CD_D_ACUTE 0
#define AZERTY_ALT_KEY_CD_I_BREVE 0
#define AZERTY_ALT_KEY_CD_D_GRAVE 0
#define AZERTY_ALT_KEY_L_ANG_SQT 0
#define AZERTY_ALT_KEY_R_ANG_SQT 0
#define AZERTY_ALT_KEY_CD_DOT_ABO 0
#define AZERTY_ALT_KEY_CD_DOT_BEL 0
#define AZERTY_ALT_KEY_PRMIL 0
#define AZERTY_ALT_KEY_DAGGER 0
#define AZERTY_ALT_KEY_D_DAGGER 0
#define AZERTY_ALT_KEY_THETA 0
#define AZERTY_ALT_KEY_THETA_UP 0
#define AZERTY_ALT_KEY_SHARP_S_UP 0
#define AZERTY_ALT_KEY_DK_CURRENCY 0
#define AZERTY_ALT_KEY_DK_GREEK 0
#define AZERTY_ALT_KEY_DK_EU 0
#define AZERTY_ALT_KEY_CD_SOLID 0
#define AZERTY_ALT_KEY_INFINITY 0
#define AZERTY_ALT_KEY_SQRT 0
#define AZERTY_ALT_KEY_FRAC_12 0
#define AZERTY_ALT_KEY_FRAC_14 0
#define AZERTY_ALT_KEY_EZH 0
#define AZERTY_ALT_KEY_EZH_UP 0
#define AZERTY_ALT_KEY_CD_STROKE 0
#define AZERTY_ALT_KEY_CD_COMMA 0
#define AZERTY_ALT_KEY_MATH_ASY 0

// macro to be used outside of this file

#define AZERTY_ALT_CHAR(character) GET_CHARACTER_KEY(AZERTY_ALT, character)
#define AZERTY_ALT_CHAR_UPPER(character) GET_CHARACTER_KEY_UPPER(AZERTY_ALT, character)

#define AZERTY_ALT_COMBINED(character) GET_COMBINED_CHAR(AZERTY_ALT, character)
#define AZERTY_ALT_COMBINED_UPPER(character) GET_COMBINED_CHAR_UPPER(AZERTY_ALT, character)
