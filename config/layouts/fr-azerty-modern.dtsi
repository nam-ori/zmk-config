/* French Modern Mappings for:
 * Linux ("Français (AZERTY, AFNOR)")
 * Windows ("Français (Standard, AZERTY)") 
 * 
 * Keys are defined as in the layout, 
 * from left to right, top to bottom.
 * Missing keys are defined at the end;
 * feel free to append those with keys needed in your layouts
 */

#ifndef OS_LAYOUT
  #define OS_LAYOUT AZERTY_MODERN
#endif

#include "commons.dtsi"

/* Note: includes dead keys (waiting to be combined)
 * named:
 *          CD_     for: "Combined Diacritic"
 *          CD_I_   for: "Combined Diacritic - Inverted"
 *          CD_D_   for: "Combined Diacritic - Double"
 *          DK_     for: "(other) Dead Key"
 *          NB_     for: "No-Break" or "Non-Breaking"
 */

// num row

#define AZERTY_MODERN_KEY_AT GRAVE
#define AZERTY_MODERN_KEY_HASH LS(GRAVE)
#define AZERTY_MODERN_KEY_CD_BREVE RA(GRAVE)
#define AZERTY_MODERN_KEY_CD_I_BREVE LS(RA(GRAVE))

#define AZERTY_MODERN_KEY_A_GRAVE N1
#define AZERTY_MODERN_KEY_N1 LS(N1)
#define AZERTY_MODERN_KEY_SECTION RA(N1)
#define AZERTY_MODERN_KEY_A_GRAVE_UP LS(RA(N1))

#define AZERTY_MODERN_KEY_E_ACUTE N2
#define AZERTY_MODERN_KEY_N2 LS(N2)
#define AZERTY_MODERN_KEY_CD_ACUTE RA(N2)
#define AZERTY_MODERN_KEY_E_ACUTE_UP LS(RA(N2))

#define AZERTY_MODERN_KEY_E_GRAVE N3
#define AZERTY_MODERN_KEY_N3 LS(N3)
#define AZERTY_MODERN_KEY_CD_GRAVE RA(N3)
#define AZERTY_MODERN_KEY_E_GRAVE_UP LS(RA(N3))

#define AZERTY_MODERN_KEY_E_CIRCU N4
#define AZERTY_MODERN_KEY_N4 LS(N4)
#define AZERTY_MODERN_KEY_AMPS RA(N4)
#define AZERTY_MODERN_KEY_E_CIRCU_UP LS(RA(N4))

#define AZERTY_MODERN_KEY_LPAR N5
#define AZERTY_MODERN_KEY_N5 LS(N5)
#define AZERTY_MODERN_KEY_LBKT RA(N5)
#define AZERTY_MODERN_KEY_CD_D_ACUTE LS(RA(N5))

#define AZERTY_MODERN_KEY_RPAR N6
#define AZERTY_MODERN_KEY_N6 LS(N6)
#define AZERTY_MODERN_KEY_RBKT RA(N6)
#define AZERTY_MODERN_KEY_CD_D_GRAVE LS(RA(N6))

#define AZERTY_MODERN_KEY_L_SQT N7
#define AZERTY_MODERN_KEY_N7 LS(N7)
#define AZERTY_MODERN_KEY_CD_MACRON RA(N7)

#define AZERTY_MODERN_KEY_R_SQT N8
#define AZERTY_MODERN_KEY_N8 LS(N8)
#define AZERTY_MODERN_KEY_UNDER RA(N8)
#define AZERTY_MODERN_KEY_EM_DASH LS(RA(N8))

#define AZERTY_MODERN_KEY_L_ANG_DQT N9
#define AZERTY_MODERN_KEY_N9 LS(N9)
#define AZERTY_MODERN_KEY_L_DQT RA(N9)
#define AZERTY_MODERN_KEY_L_ANG_SQT LS(RA(N9))

#define AZERTY_MODERN_KEY_R_ANG_DQT N0
#define AZERTY_MODERN_KEY_N0 LS(N0)
#define AZERTY_MODERN_KEY_R_DQT RA(N0)
#define AZERTY_MODERN_KEY_R_ANG_SQT LS(RA(N0))

#define AZERTY_MODERN_KEY_SQT MINUS
#define AZERTY_MODERN_KEY_DQT LS(MINUS)
#define AZERTY_MODERN_KEY_DEGREE RA(MINUS)
#define AZERTY_MODERN_KEY_CD_RING LS(RA(MINUS))

#define AZERTY_MODERN_KEY_CD_CIRCU EQUAL
#define AZERTY_MODERN_KEY_CD_DIAER LS(EQUAL)
#define AZERTY_MODERN_KEY_CD_CARON RA(EQUAL)

// top letter row

#define AZERTY_MODERN_KEY_A Q
#define AZERTY_MODERN_KEY_AE RA(Q)
#define AZERTY_MODERN_KEY_AE_UP LS(RA(Q))

#define AZERTY_MODERN_KEY_Z W
#define AZERTY_MODERN_KEY_UK_POUND RA(W)

#define AZERTY_MODERN_KEY_E E
#define AZERTY_MODERN_KEY_EURO RA(E)

#define AZERTY_MODERN_KEY_R R
#define AZERTY_MODERN_KEY_REG RA(R)

#define AZERTY_MODERN_KEY_T T
#define AZERTY_MODERN_KEY_LBRC RA(T)
#define AZERTY_MODERN_KEY_TM LS(RA(T))

#define AZERTY_MODERN_KEY_Y Y
#define AZERTY_MODERN_KEY_RBRC RA(Y)

#define AZERTY_MODERN_KEY_U U
#define AZERTY_MODERN_KEY_U_GRAVE RA(U)
#define AZERTY_MODERN_KEY_U_GRAVE_UP LS(RA(U))

#define AZERTY_MODERN_KEY_I I
#define AZERTY_MODERN_KEY_CD_DOT_ABO RA(I)
#define AZERTY_MODERN_KEY_CD_DOT_BEL LS(RA(I))

#define AZERTY_MODERN_KEY_O O
#define AZERTY_MODERN_KEY_OE RA(O)
#define AZERTY_MODERN_KEY_OE_UP LS(RA(O))

#define AZERTY_MODERN_KEY_P P
#define AZERTY_MODERN_KEY_PRCNT RA(P)
#define AZERTY_MODERN_KEY_PRMIL LS(RA(P))

#define AZERTY_MODERN_KEY_MINUS LBKT
#define AZERTY_MODERN_KEY_EN_DASH LS(LBKT)
#define AZERTY_MODERN_KEY_MATH_MINUS RA(LBKT)
#define AZERTY_MODERN_KEY_NB_HYPHEN LS(RA(LBKT))

#define AZERTY_MODERN_KEY_PLUS RBKT
#define AZERTY_MODERN_KEY_MATH_PM LS(RBKT)
#define AZERTY_MODERN_KEY_DAGGER RA(RBKT)
#define AZERTY_MODERN_KEY_D_DAGGER LS(RA(RBKT))

// mid letter row

#define AZERTY_MODERN_KEY_Q A
#define AZERTY_MODERN_KEY_THETA RA(A)
#define AZERTY_MODERN_KEY_THETA_UP LS(RA(A))


#define AZERTY_MODERN_KEY_S S
#define AZERTY_MODERN_KEY_SHARP_S RA(S)
#define AZERTY_MODERN_KEY_SHARP_S_UP LS(RA(S))

#define AZERTY_MODERN_KEY_D D
#define AZERTY_MODERN_KEY_DLLR RA(D)

#define AZERTY_MODERN_KEY_F F
#define AZERTY_MODERN_KEY_DK_CURRENCY RA(F)

#define AZERTY_MODERN_KEY_G G
#define AZERTY_MODERN_KEY_DK_GREEK RA(G)

#define AZERTY_MODERN_KEY_H H
#define AZERTY_MODERN_KEY_DK_EU RA(H)

#define AZERTY_MODERN_KEY_J J

#define AZERTY_MODERN_KEY_K K
#define AZERTY_MODERN_KEY_CD_SOLID RA(K)

#define AZERTY_MODERN_KEY_L L
#define AZERTY_MODERN_KEY_PIPE RA(L)

#define AZERTY_MODERN_KEY_M SEMI
#define AZERTY_MODERN_KEY_INFINITY RA(M)

#define AZERTY_MODERN_KEY_FSLH SQT
#define AZERTY_MODERN_KEY_BSLH LS(SQT)
#define AZERTY_MODERN_KEY_MATH_DIV RA(SQT)
#define AZERTY_MODERN_KEY_SQRT LS(RA(SQT))

#define AZERTY_MODERN_KEY_STAR NUHS
#define AZERTY_MODERN_KEY_FRAC_12 LS(NUHS)
#define AZERTY_MODERN_KEY_MULTIPL RA(NUHS)
#define AZERTY_MODERN_KEY_FRAC_14 LS(RA(NUHS))

// low letter row

#define AZERTY_MODERN_KEY_LT NUBS
#define AZERTY_MODERN_KEY_GT LS(NUBS)
#define AZERTY_MODERN_KEY_LET RA(NUBS)
#define AZERTY_MODERN_KEY_GET LS(RA(NUBS))

#define AZERTY_MODERN_KEY_W Z
#define AZERTY_MODERN_KEY_EZH RA(Z)
#define AZERTY_MODERN_KEY_EZH_UP LS(RA(Z))

#define AZERTY_MODERN_KEY_X X
#define AZERTY_MODERN_KEY_COPYRIGHT RA(X)

#define AZERTY_MODERN_KEY_C C
#define AZERTY_MODERN_KEY_C_CEDIL RA(C)
#define AZERTY_MODERN_KEY_C_CEDIL_UP LS(RA(C))

#define AZERTY_MODERN_KEY_V V
#define AZERTY_MODERN_KEY_CD_CEDILLA RA(V)
#define AZERTY_MODERN_KEY_CD_OGONEK LS(RA(V))

#define AZERTY_MODERN_KEY_B B
#define AZERTY_MODERN_KEY_CD_STROKE RA(B)

#define AZERTY_MODERN_KEY_N N
#define AZERTY_MODERN_KEY_CD_TILDE RA(N)

#define AZERTY_MODERN_KEY_PERIOD M
#define AZERTY_MODERN_KEY_QMARK LS(M)
#define AZERTY_MODERN_KEY_I_QMARK RA(M)

#define AZERTY_MODERN_KEY_COMMA COMMA
#define AZERTY_MODERN_KEY_EXCL LS(COMMA)
#define AZERTY_MODERN_KEY_I_EXCL RA(COMMA)
#define AZERTY_MODERN_KEY_CD_COMMA LS(RA(COMMA))

#define AZERTY_MODERN_KEY_COLON DOT
#define AZERTY_MODERN_KEY_ELLIPS LS(DOT)
#define AZERTY_MODERN_KEY_MID_DOT RA(DOT)

#define AZERTY_MODERN_KEY_SEMI SLASH
#define AZERTY_MODERN_KEY_EQUAL LS(SLASH)
#define AZERTY_MODERN_KEY_MATH_ASY RA(SLASH)
#define AZERTY_MODERN_KEY_MATH_DIF LS(RA(SLASH))

// spaebar

#define AZERTY_MODERN_KEY_SPACE SPACE
#define AZERTY_MODERN_KEY_NB_SPACE RA(SPACE)
#define AZERTY_MODERN_KEY_NAR_SPACE LS(RA(SPACE))

// combined keys for a character (combined diacritic)

#define AZERTY_MODERN_COMBINED_A_GRAVE &kp AZERTY_MODERN_KEY_A_GRAVE
#define AZERTY_MODERN_COMBINED_A_GRAVE_UP &kp AZERTY_MODERN_KEY_A_GRAVE_UP
#define AZERTY_MODERN_COMBINED_A_CIRCU &kp AZERTY_MODERN_KEY_CD_CIRCU &kp AZERTY_MODERN_KEY_A
#define AZERTY_MODERN_COMBINED_A_CIRCU_UP &kp AZERTY_MODERN_KEY_CD_CIRCU &kp LS(AZERTY_MODERN_KEY_A)
#define AZERTY_MODERN_COMBINED_E_GRAVE &kp AZERTY_MODERN_KEY_E_GRAVE
#define AZERTY_MODERN_COMBINED_E_GRAVE_UP &kp AZERTY_MODERN_KEY_E_GRAVE_UP
#define AZERTY_MODERN_COMBINED_E_ACUTE &kp AZERTY_MODERN_KEY_E_ACUTE
#define AZERTY_MODERN_COMBINED_E_ACUTE_UP &kp AZERTY_MODERN_KEY_E_ACUTE_UP
#define AZERTY_MODERN_COMBINED_E_CIRCU &kp AZERTY_MODERN_KEY_E_CIRCU
#define AZERTY_MODERN_COMBINED_E_CIRCU_UP &kp AZERTY_MODERN_KEY_E_CIRCU_UP
#define AZERTY_MODERN_COMBINED_E_DIAER &kp AZERTY_MODERN_KEY_CD_DIAER &kp AZERTY_MODERN_KEY_E
#define AZERTY_MODERN_COMBINED_E_DIAER_UP &kp AZERTY_MODERN_KEY_CD_DIAER &kp LS(AZERTY_MODERN_KEY_E)
#define AZERTY_MODERN_COMBINED_I_CIRCU &kp AZERTY_MODERN_KEY_CD_CIRCU &kp AZERTY_MODERN_KEY_I
#define AZERTY_MODERN_COMBINED_I_CIRCU_UP &kp AZERTY_MODERN_KEY_CD_CIRCU &kp LS(AZERTY_MODERN_KEY_I)
#define AZERTY_MODERN_COMBINED_I_DIAER &kp AZERTY_MODERN_KEY_CD_DIAER &kp AZERTY_MODERN_KEY_I
#define AZERTY_MODERN_COMBINED_I_DIAER_UP &kp AZERTY_MODERN_KEY_CD_DIAER &kp LS(AZERTY_MODERN_KEY_I)
#define AZERTY_MODERN_COMBINED_O_CIRCU &kp AZERTY_MODERN_KEY_CD_CIRCU &kp AZERTY_MODERN_KEY_O
#define AZERTY_MODERN_COMBINED_O_CIRCU_UP &kp AZERTY_MODERN_KEY_CD_CIRCU &kp LS(AZERTY_MODERN_KEY_O)
#define AZERTY_MODERN_COMBINED_U_GRAVE &kp AZERTY_MODERN_KEY_U_GRAVE
#define AZERTY_MODERN_COMBINED_U_GRAVE_UP &kp AZERTY_MODERN_KEY_U_GRAVE_UP
#define AZERTY_MODERN_COMBINED_U_CIRCU &kp AZERTY_MODERN_KEY_CD_CIRCU &kp AZERTY_MODERN_KEY_U
#define AZERTY_MODERN_COMBINED_U_CIRCU_UP &kp AZERTY_MODERN_KEY_CD_CIRCU &kp LS(AZERTY_MODERN_KEY_U)
#define AZERTY_MODERN_COMBINED_U_DIAER &kp AZERTY_MODERN_KEY_CD_DIAER &kp AZERTY_MODERN_KEY_U
#define AZERTY_MODERN_COMBINED_U_DIAER_UP &kp AZERTY_MODERN_KEY_CD_DIAER &kp LS(AZERTY_MODERN_KEY_U)
#define AZERTY_MODERN_COMBINED_C_CEDIL &kp AZERTY_MODERN_KEY_C_CEDIL
#define AZERTY_MODERN_COMBINED_C_CEDIL_UP &kp AZERTY_MODERN_KEY_C_CEDIL_UP

// combined keys for a character (others)

#define AZERTY_MODERN_COMBINED_MICRO &kp AZERTY_MODERN_KEY_DK_GREEK &kp AZERTY_MODERN_KEY_SPACE
#define AZERTY_MODERN_COMBINED_CARET &kp AZERTY_MODERN_KEY_CD_CIRCU &kp AZERTY_MODERN_KEY_SPACE
#define AZERTY_MODERN_COMBINED_ACUTE &kp AZERTY_MODERN_KEY_CD_ACUTE &kp AZERTY_MODERN_KEY_SPACE
#define AZERTY_MODERN_COMBINED_GRAVE &kp AZERTY_MODERN_KEY_CD_GRAVE &kp AZERTY_MODERN_KEY_SPACE
#define AZERTY_MODERN_COMBINED_TILDE &kp AZERTY_MODERN_KEY_CD_TILDE &kp AZERTY_MODERN_KEY_SPACE
#define AZERTY_MODERN_COMBINED_EXPON_1 &kp AZERTY_MODERN_KEY_CD_CIRCU &kp AZERTY_MODERN_KEY_N1
#define AZERTY_MODERN_COMBINED_INDEX_1 &kp AZERTY_MODERN_KEY_CD_CARON &kp AZERTY_MODERN_KEY_N1
#define AZERTY_MODERN_COMBINED_EXPON_2 &kp AZERTY_MODERN_KEY_CD_CIRCU &kp AZERTY_MODERN_KEY_N2
#define AZERTY_MODERN_COMBINED_INDEX_2 &kp AZERTY_MODERN_KEY_CD_CARON &kp AZERTY_MODERN_KEY_N2
#define AZERTY_MODERN_COMBINED_EXPON_3 &kp AZERTY_MODERN_KEY_CD_CIRCU &kp AZERTY_MODERN_KEY_N3
#define AZERTY_MODERN_COMBINED_INDEX_3 &kp AZERTY_MODERN_KEY_CD_CARON &kp AZERTY_MODERN_KEY_N3
#define AZERTY_MODERN_COMBINED_EXPON_4 &kp AZERTY_MODERN_KEY_CD_CIRCU &kp AZERTY_MODERN_KEY_N4
#define AZERTY_MODERN_COMBINED_INDEX_4 &kp AZERTY_MODERN_KEY_CD_CARON &kp AZERTY_MODERN_KEY_N4
#define AZERTY_MODERN_COMBINED_EXPON_5 &kp AZERTY_MODERN_KEY_CD_CIRCU &kp AZERTY_MODERN_KEY_N5
#define AZERTY_MODERN_COMBINED_INDEX_5 &kp AZERTY_MODERN_KEY_CD_CARON &kp AZERTY_MODERN_KEY_N5
#define AZERTY_MODERN_COMBINED_EXPON_6 &kp AZERTY_MODERN_KEY_CD_CIRCU &kp AZERTY_MODERN_KEY_N6
#define AZERTY_MODERN_COMBINED_INDEX_6 &kp AZERTY_MODERN_KEY_CD_CARON &kp AZERTY_MODERN_KEY_N6
#define AZERTY_MODERN_COMBINED_EXPON_7 &kp AZERTY_MODERN_KEY_CD_CIRCU &kp AZERTY_MODERN_KEY_N7
#define AZERTY_MODERN_COMBINED_INDEX_7 &kp AZERTY_MODERN_KEY_CD_CARON &kp AZERTY_MODERN_KEY_N7
#define AZERTY_MODERN_COMBINED_EXPON_8 &kp AZERTY_MODERN_KEY_CD_CIRCU &kp AZERTY_MODERN_KEY_N8
#define AZERTY_MODERN_COMBINED_INDEX_8 &kp AZERTY_MODERN_KEY_CD_CARON &kp AZERTY_MODERN_KEY_N8
#define AZERTY_MODERN_COMBINED_EXPON_9 &kp AZERTY_MODERN_KEY_CD_CIRCU &kp AZERTY_MODERN_KEY_N9
#define AZERTY_MODERN_COMBINED_INDEX_9 &kp AZERTY_MODERN_KEY_CD_CARON &kp AZERTY_MODERN_KEY_N9
#define AZERTY_MODERN_COMBINED_EXPON_0 &kp AZERTY_MODERN_KEY_CD_CIRCU &kp AZERTY_MODERN_KEY_N0
#define AZERTY_MODERN_COMBINED_INDEX_0 &kp AZERTY_MODERN_KEY_CD_CARON &kp AZERTY_MODERN_KEY_N0

// undefined keys in this layout - append if needed!

#define AZERTY_MODERN_KEY_NEGATION 0
#define AZERTY_MODERN_KEY_BULLET 0
#define AZERTY_MODERN_KEY_FRAC_3_4 0
#define AZERTY_MODERN_KEY_CENT 0

// macro to be used outside of this file

#define AZERTY_MODERN_CHAR(character) GET_CHARACTER_KEY(AZERTY_MODERN, character)
#define AZERTY_MODERN_CHAR_UPPER(character) GET_CHARACTER_KEY_UPPER(AZERTY_MODERN, character)

#define AZERTY_MODERN_COMBINED(character) GET_COMBINED_CHAR(AZERTY_MODERN, character)
#define AZERTY_MODERN_COMBINED_UPPER(character) GET_COMBINED_CHAR_UPPER(AZERTY_MODERN, character)

